## boards/shields/peacock/Kconfig.defconfig
```kconfig
if SHIELD_PEACOCK

config ZMK_KEYBOARD_NAME
    default "peacock"

config ZMK_USB
    default "y"

endif
```

## boards/shields/peacock/Kconfig.shield
```kconfig
config SHIELD_PEACOCK
    def_bool $(shields_list_contains,peacock)
    imply ZMK_MOUSE
    imply ZMK_TRACKPAD
    select I2C
```

## config/west.yml
```yaml
manifest:
  remotes:
    - name: zmkfirmware
      url-base: https://github.com/zmkfirmware
    - name: taz
      url-base: https://github.com/thazhemadam
    - name: fingerpunch
      url-base: https://github.com/sadekbaroudi
    - name: petejohanson
      url-base: https://github.com/petejohanson
    - name: urob
      url-base: https://github.com/urob
    - name: bullwinkle3000
      url-base: https://github.com/bullwinkle3000
    - name: numToStr
      url-base: https://github.com/keeb-it
    - name: kumamuk
      url-base: https://github.com/kumamuk-git
  projects:
    - name: zmk
      remote: zmkfirmware
      revision: main
      # revision: feat/pointers-move-scroll-ptp  # necessary for peacock trackpad
      import: app/west.yml
    - name: zmk-helpers
      remote: urob
      revision: main
    - name: zmk-auto-layer
      remote: urob
      revision: main
    - name: zmk-tri-state
      remote: urob
      revision: main
    - name: zmk-fingerpunch-vik
      remote: fingerpunch
      revision: main
      import: config/deps.yml
    - name: zmk-keyboard-totem-7racker
      remote: taz
      revision: main
    - name: zmk-keyboard-kaizen
      remote: taz
      revision: main
    - name: zmk-keyboard-chocV
      remote: taz
      revision: main
    - name: zmk-keyboards
      remote: numToStr
      revision: main
    - name: zmk-fingerpunch-keyboards
      remote: fingerpunch
      revision: main
      import: config/deps.yml
    - name: zmk-config-roBa
      remote: taz
      revision: main
    - name: zmk-pmw3610-driver
      remote: kumamuk
      revision: main
    # - name: zmk-pmw3610-driver
    #   remote: bullwinkle3000
    #   revision: pmw3360
    - name: cirque-input-module
      remote: petejohanson
      revision: main
    - name: chiptuner-zmk-module
      remote: petejohanson
      revision: main
    # - name: maxtouch-zephyr-module
    #   remote: petejohanson
    #   revision: main
    #   import: config/west.yml
  self:
    path: config
```
