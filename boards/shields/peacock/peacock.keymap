#include <behaviors.dtsi>
#include <dt-bindings/zmk/keys.h>

/*
 * Assign a random key for the keymap
 * since you cannot have a ZMK configuration without any
 * keymap defined, as of this writing.
 */
/ {
    keymap {
        compatible = "zmk,keymap";

        base {
            bindings = <
&bootloader
            >;
        };
    };
};
