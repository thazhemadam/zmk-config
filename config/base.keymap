#include <behaviors.dtsi>
#include <dt-bindings/zmk/keys.h>

#ifdef CONFIG_WIRELESS
    #include <dt-bindings/zmk/bt.h>
    #define _BT_SEL_KEYS_ &bt BT_SEL 0 &bt BT_SEL 1 &bt BT_SEL 2 &bt BT_SEL 3 &bt BT_CLR
#else
    #define _BT_SEL_KEYS_ &trans &trans &trans &trans &trans
#endif

#include "zmk-helpers/helper.h"
#include "include/layers.h"

/* Global settings */
#ifndef QUICK_TAP_MS
#define QUICK_TAP_MS 175
#endif

#ifndef HRM_TAPPING_TERM_MS
#define HRM_TAPPING_TERM_MS 280
#endif

#ifndef TAPPING_TERM_MS
#define TAPPING_TERM_MS 200
#endif

&sk {  // sticky-key config
    release-after-ms = <900>;  // release after 0.9s
    quick-release;             // no double capitalization when rolling keys
};

&sl {  // sticky-layer config
    ignore-modifiers;          // allow chording sticky mods & layers
};

&lt {  // layer-tap config
    flavor = "balanced";
    tapping-term-ms = <TAPPING_TERM_MS>;
    quick-tap-ms = <QUICK_TAP_MS>;
};

/* Homerow mods */
#include "include/home-row.dtsi"

/* Combos, mouse emulation */
#include "include/combos.dtsi"  // must be sources after HRM-combo hack
#include "include/mouse.dtsi"
#include "include/key-labels/extra_keys.h"

// long-tap action on hold, short-tap action on all interrupts
#define MT_CORE \
    flavor = "tap-preferred"; \
    tapping-term-ms = <TAPPING_TERM_MS>; \
    quick-tap-ms = <220>; \
    hold-trigger-key-positions = <0>;

&mt { MT_CORE };
ZMK_HOLD_TAP(mt_home, bindings = <&masked_home>, <&kp>; MT_CORE)
ZMK_HOLD_TAP(mt_end, bindings = <&masked_end>, <&kp>; MT_CORE)

// mask CTRL when holding left/right to avoid accidental jumps to beginning/end of document
#define MASK_MODS(NAME, MODS, BINDING) \
    ZMK_MOD_MORPH(NAME, \
        bindings = <BINDING>, <BINDING>; \
        mods = <MODS>; \
    )
MASK_MODS(masked_home, (MOD_LCTL), &kp HOME)
MASK_MODS(masked_end,  (MOD_LCTL), &kp END)

/* Smart layers - caps-word, num-word and smart-mouse */
#include "include/smart-layers.dtsi"

/* Custom behaviors */
#include "include/custom-behaviors.dtsi"

/* Keymap */
#include "include/keymap.dtsi"
