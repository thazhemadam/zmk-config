#include "zmk-helpers/key-labels/36.h"
#include "ffkb_v2.dtsi"

#define X_LH_N 2
#define X_LH_0 &none SYSCAPE

#define X_RH_N 2
#define X_RH_0 DELMOUSE &none

#include "base.keymap"
ZMK_APPLY_MATRIX_TRANSFORM(five_col_transform)
