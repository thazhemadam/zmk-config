#include "include/key-labels/vulpes_majora_v1_42.h"

#define X_LT &kp A
#define X_LM &kp B
#define X_LB &kp C
#define X_LH SYSCAPE

#define X_MH &kp E   &kp F   &kp G

#define X_RT &kp H
#define X_RM &kp I
#define X_RB &kp J
#define X_RH                          \
                        DELMOUSE      \
        &kp N1  &kp N2  &kp N3          /* left  thumb rockers */  \
        &kp N4  &kp N5  &kp N6          /* right thumb rockers */  \
    &kp L  &kp M  &kp N  &kp O  &kp P   /* left  5-way switch  */  \
    &kp Q  &kp R  &kp S  &kp T  &kp U   /* right 5-way switch  */

#include "base.keymap"
