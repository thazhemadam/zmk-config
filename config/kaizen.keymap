#include "zmk-helpers/key-labels/36.h"

#define X_LH_N 1
#define X_LH_0 SYSCAPE

#define X_RH_N 11
#define X_RH_0                                              \
                                          DELMOUSE  \
             &kp F15                      &kp F20           \
    &kp F16  &kp F17  &kp F18    &kp F21  &kp F22  &kp F23  \
             &kp F19                      &kp F24

#include "base.keymap"
