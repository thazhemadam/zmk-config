#include "zmk-helpers/key-labels/36.h"

#define X_LH_N 1
#define X_LH_0 SYSCAPE

#define X_RH_N 1
#define X_RH_0 DELMOUSE

#define HRM_TAPPING_TERM_MS 240

#include "base.keymap"

ZMK_APPLY_MATRIX_TRANSFORM(five_col_transform)
